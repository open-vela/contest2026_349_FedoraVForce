## board/contest_board/Kconfig
```kconfig
#
# vendor/openvela/boards/contest2026_349_board/Kconfig
#

comment "VSAI LogicPi A1 Configuration"

config VSAI_LOGICPI_A1_TOUCH
	bool "GT911 touch panel"
	default n
	select BOARD_LATE_INITIALIZE
	select INPUT
	select INPUT_GT9XX
	select S6_GPIO
	select S6_I2C
	---help---
		Enable the GT911 touch panel connected to I2C0.
```

## board/contest_board/configs/nsh/defconfig
```kconfig
#
# Minimal UART/NSH configuration for VSAI LogicPi A1.
#

CONFIG_ARCH="arm64"
CONFIG_ARCH_ARM64=y
CONFIG_ARCH_BOARD="vsai-logicpi-a1"
CONFIG_ARCH_BOARD_CUSTOM=y
CONFIG_ARCH_BOARD_CUSTOM_DIR="../vendor/openvela/boards/contest2026_349_board"
CONFIG_ARCH_BOARD_CUSTOM_DIR_RELPATH=y
CONFIG_ARCH_BOARD_CUSTOM_NAME="vsai-logicpi-a1"
CONFIG_ARCH_CHIP="s6"
CONFIG_ARCH_CHIP_S6=y

CONFIG_ARCH_EARLY_PRINT=y
CONFIG_ARCH_INTERRUPTSTACK=4096
CONFIG_ARCH_IRQPRIO=y

CONFIG_BOARD_LOOPSPERMSEC=100000
CONFIG_BUILTIN=y
CONFIG_DEBUG_ASSERTIONS=y
CONFIG_DEBUG_FEATURES=y
CONFIG_DEBUG_SYMBOLS=y
CONFIG_DEFAULT_TASK_STACKSIZE=8192
CONFIG_IDLETHREAD_STACKSIZE=8192
CONFIG_INIT_ENTRYPOINT="nsh_main"
CONFIG_NSH_BUILTIN_APPS=y
CONFIG_NSH_FILEIOSIZE=512
CONFIG_NSH_READLINE=y
CONFIG_PTHREAD_STACK_MIN=8192
CONFIG_RAM_SIZE=16777216
CONFIG_RAM_START=0x03000000
CONFIG_RAW_BINARY=y
CONFIG_SYSTEM_NSH=y
CONFIG_UART0_BAUD=921600
CONFIG_UART0_SERIAL_CONSOLE=y
CONFIG_USEC_PER_TICK=1000

CONFIG_FS_PROCFS=y
CONFIG_FS_PROCFS_REGISTER=y

CONFIG_NSH_DISABLE_MB=n
CONFIG_NSH_DISABLE_MH=n
CONFIG_NSH_DISABLE_MW=n

CONFIG_DRIVERS_VIDEO=y
CONFIG_VIDEO_FB=y
CONFIG_S6_MIPI_DSI=y
CONFIG_EXAMPLES_FB=y

CONFIG_VSAI_LOGICPI_A1_TOUCH=y

CONFIG_INPUT_GT9XX_I2C_FREQUENCY=100000
```
